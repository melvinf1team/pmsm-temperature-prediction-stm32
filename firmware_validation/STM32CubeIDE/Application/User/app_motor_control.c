#include "app_motor_control.h"

#include "main.h"
#include "motorcontrol.h"
#include "mc_api.h"
#include "mc_interface.h"
#include "mc_type.h"
#include "mc_tasks.h"
#include "d6t_ir.h"
#include "pmsm_motor_parameters.h"
#include "drive_parameters.h"
#include "pidreg_speed.h"
#include "fixpmath.h"
#include "app_datalog.h"
#include "app_fault_diag.h"
#include "app_foc_timing.h"

#include <stdbool.h>
#include <math.h>
#include <stdio.h>
#include <string.h>

/*
 * ================================
 * DEFAULT CONFIGURATION
 * ================================
 */

/*
 * IMPORTANT:
 * Automatic startup at boot must be disabled when using the Python GUI.
 * The motor starts only after a PC start command or a press of B2.
 */
#define APP_MOTOR_AUTOSTART_ENABLE          0

#define APP_MOTOR_START_DELAY_MS            3000U

#define APP_DEFAULT_TARGET_SPEED_RPM        600.0f
#define APP_DEFAULT_IQ_LIMIT_A              2.0f
#define APP_DEFAULT_HARD_STOP_CURRENT_A     8.0f
#define APP_DEFAULT_ACCEL_ELEC_HZ_S         2.0f

#define APP_CURRENT_CHECK_AFTER_RUN_MS      500U
#define APP_HARD_STOP_DEBOUNCE_MS           50U
#define APP_STARTUP_TIMEOUT_MS              5000U

/* Overspeed protection: stop the motor if the estimated speed significantly
 * exceeds the setpoint during RUN. */
#define APP_OVERSPEED_CHECK_AFTER_RUN_MS    800U
#define APP_OVERSPEED_DEBOUNCE_MS           100U
#define APP_OVERSPEED_RATIO                 1.35f
#define APP_OVERSPEED_MARGIN_RPM            150.0f

#define APP_CFG_MIN_TARGET_SPEED_RPM        100.0f
#define APP_CFG_MAX_ACCEL_ELEC_HZ_S         50.0f

/* Standalone variable profile selected by the blue B2 button (PC13). */
#define APP_BUTTON_MIN_TARGET_SPEED_RPM     3000.0f
#define APP_BUTTON_MAX_TARGET_SPEED_RPM     4000.0f
#define APP_BUTTON_MIN_CHANGE_PERIOD_MS     2000U
#define APP_BUTTON_MAX_CHANGE_PERIOD_MS     5000U
#define APP_BUTTON_IQ_LIMIT_A               28.0f
#define APP_BUTTON_HARD_STOP_CURRENT_A      30.0f
#define APP_BUTTON_ACCEL_ELEC_HZ_S          500.0f
#define APP_BUTTON_DEBOUNCE_MS              250U
#define APP_START_RETRY_PERIOD_MS            100U

/* Validation profiles controlled through the serial interface. */
#define APP_PROFILE_FIXED_SPEED_RPM         4000.0f
#define APP_PROFILE_FIXED_LOAD_A               0.20f

/* TB-200S: bench calibration line (PA5 voltage -> TB-200S displayed current),
 * calibrate_tb200s.py, 2026-10-14: 0.2567 A/V, threshold 0.194 V, max error 0.003 A.
 * The TB-200S saturates near 0.24 A: the 0.25 A point is excluded from the fit. */
#define APP_TB200S_DAC_VREF_V               3.3f
#define APP_TB200S_CAL_LOW_V                0.3892f
#define APP_TB200S_CAL_LOW_A                0.05f
#define APP_TB200S_CAL_HIGH_V               1.1683f
#define APP_TB200S_CAL_HIGH_A               0.25f
#define APP_TB200S_DAC_MAX_CODE              4095U
#define APP_TB200S_MIN_CHANGE_PERIOD_MS      2000U
#define APP_TB200S_MAX_CHANGE_PERIOD_MS      5000U

/*
 * The speed PI generated by Workbench is too aggressive when more than 5 A
 * is allowed. Reduce its gains at runtime to avoid immediate torque demands
 * of 6-8 A at startup.
 */
#define APP_SPEED_PID_KP_FACTOR             0.45f
#define APP_SPEED_PID_KI_FACTOR             0.20f

/*
 * Even if the user requests up to 28 A, start with a lower limit and ramp it
 * gradually during RUN. This avoids a sudden spike when speed control
 * takes over.
 */
#define APP_IQ_START_LIMIT_A                4.5f
#define APP_IQ_LIMIT_RAMP_A_PER_S           1.5f

extern MCI_Handle_t *pMCI[NBR_OF_MOTORS];
extern DAC_HandleTypeDef hdac1;

typedef enum
{
  APP_TB200S_LOAD_FIXED = 0,
  APP_TB200S_LOAD_VARIABLE
} AppTb200sLoadMode_t;

typedef enum
{
  APP_MC_IDLE = 0,
  APP_MC_WAIT_AUTOSTART,
  APP_MC_STARTING,
  APP_MC_RUNNING,
  APP_MC_FAULT
} AppMotorControlState_t;

typedef enum
{
  APP_CUSTOM_OFF = 0,
  APP_CUSTOM_INITIAL_SPEED,
  APP_CUSTOM_SPEED_RAMP,
  APP_CUSTOM_FINAL_SPEED,
  APP_CUSTOM_LOAD_RAMP,
  APP_CUSTOM_DONE
} AppCustomStartPhase_t;

static AppMotorControlState_t app_mc_state = APP_MC_IDLE;
static const char *app_mc_fault_reason = "NONE";
static char app_fault_report[256];
static bool app_fault_report_pending = false;

static uint32_t app_mc_boot_ms = 0U;
static uint32_t app_mc_start_ms = 0U;
static uint32_t app_mc_run_enter_ms = 0U;
static uint32_t app_mc_overcurrent_since_ms = 0U;
static uint32_t app_mc_overspeed_since_ms = 0U;

/* The B2 IRQ never controls MCSDK directly: it queues a request that is
 * processed later in the main loop. */
static volatile bool app_button_toggle_pending = false;
static volatile bool app_button_irq_seen = false;
static volatile uint32_t app_button_last_irq_ms = 0U;
static bool app_motor_start_requested = false;
static uint32_t app_motor_next_start_attempt_ms = 0U;
static bool app_button_profile_active = false;
static bool app_button_speed_variable = false;
static bool app_button_speed_change_scheduled = false;
static uint32_t app_button_next_speed_change_ms = 0U;
static uint32_t app_button_random_state = 0x6D2B79F5U;

static AppTb200sLoadMode_t app_tb200s_load_mode = APP_TB200S_LOAD_FIXED;
static float app_tb200s_requested_load_a = APP_TB200S_MIN_LOAD_A;
static float app_tb200s_load_setpoint_a = APP_TB200S_MIN_LOAD_A;
static bool app_tb200s_change_scheduled = false;
static uint32_t app_tb200s_next_change_ms = 0U;

static float app_target_speed_rpm = APP_DEFAULT_TARGET_SPEED_RPM;
static float app_iq_limit_a = APP_DEFAULT_IQ_LIMIT_A;
static float app_active_iq_limit_a = APP_DEFAULT_IQ_LIMIT_A;
static uint32_t app_iq_ramp_last_ms = 0U;
static float app_hard_stop_current_a = APP_DEFAULT_HARD_STOP_CURRENT_A;
static float app_accel_elec_hz_s = APP_DEFAULT_ACCEL_ELEC_HZ_S;

static AppCustomStartPhase_t app_custom_phase = APP_CUSTOM_OFF;
static float app_custom_speed_ref_rpm = 0.0f;
static uint32_t app_custom_last_ms = 0U;
static uint32_t app_custom_stable_since_ms = 0U;
static uint32_t app_custom_unstable_since_ms = 0U;
static bool app_custom_speed_stable = false;
static bool app_custom_speed_unstable = false;

static float app_active_id_a = 0.0f;
static uint32_t app_id_ramp_last_ms = 0U;
static uint32_t app_id_speed_stable_since_ms = 0U;
static bool app_id_speed_stable = false;
static bool app_thermal_latched = false;

static void AppMotorControl_ApplySpeedReference(void);
static float AppMotorControl_GetOverspeedReferenceRpm(void);

static bool AppMotorControl_IsCustomStartActive(void)
{
  return (app_custom_phase != APP_CUSTOM_OFF) &&
         (app_custom_phase != APP_CUSTOM_DONE);
}

static void AppMotorControl_ResetCustomStart(void)
{
  app_custom_phase = APP_CUSTOM_OFF;
  app_custom_speed_ref_rpm = 0.0f;
  app_custom_last_ms = 0U;
  app_custom_speed_stable = false;
  app_custom_speed_unstable = false;
}

static void AppMotorControl_BeginCustomStart(float initial_speed_rpm)
{
  app_custom_phase = APP_CUSTOM_INITIAL_SPEED;
  app_custom_speed_ref_rpm = initial_speed_rpm;
  app_custom_last_ms = HAL_GetTick();
  app_custom_speed_stable = false;
  app_custom_speed_unstable = false;
}

static bool AppMotorControl_IsFiniteFloat(float value)
{
  uint32_t bits;

  /* The project is built with -Ofast: a standard isfinite() check may be
   * removed by -ffinite-math-only. The IEEE-754 bitwise check remains active. */
  memcpy(&bits, &value, sizeof(bits));
  return (bits & 0x7F800000U) != 0x7F800000U;
}

static long AppMotorControl_DiagnosticMilli(float value)
{
  if (!AppMotorControl_IsFiniteFloat(value) || (fabsf(value) > 1000000.0f))
  {
    return 0L;
  }
  return (long)(value * 1000.0f);
}

static void AppMotorControl_ReportPendingFault(void)
{
  if (app_fault_report_pending && AppDatalog_SendText(app_fault_report))
  {
    app_fault_report_pending = false;
  }
  /* #FAULT_DIAG / #FAULT_TRACE always follow the #FAULT line. */
  if (!app_fault_report_pending)
  {
    (void)AppFaultDiag_SendPendingReport();
  }
}

static void AppMotorControl_SetFault(const char *reason)
{
  if ((app_mc_state != APP_MC_FAULT) || strcmp(reason, app_mc_fault_reason) != 0)
  {
    float speed_rpm = MC_GetSpeedMotor1_F() * 60.0f / (float)POLE_PAIR_NUM;
    float speed_limit_rpm = fminf(APP_MOTOR_OVERSPEED_LIMIT_RPM,
      AppMotorControl_GetOverspeedReferenceRpm() * APP_OVERSPEED_RATIO +
      APP_OVERSPEED_MARGIN_RPM);
    dq_float_t current = MC_GetCurrentMotor1_F();
    /* Capture before stopping: STOP resets the brake and speed references. */
    (void)snprintf(app_fault_report, sizeof(app_fault_report),
      "#FAULT,%s,t_ms=%lu,speed_mrpm=%ld,speed_limit_rpm=%ld,"
      "iq_ma=%ld,id_ma=%ld,hard_ma=%ld,load_ma=%ld,"
      "mc_now=0x%04lX,mc_occurred=0x%04lX\r\n",
      reason, (unsigned long)HAL_GetTick(),
      AppMotorControl_DiagnosticMilli(speed_rpm),
      AppMotorControl_DiagnosticMilli(speed_limit_rpm) / 1000L,
      AppMotorControl_DiagnosticMilli(current.Q),
      AppMotorControl_DiagnosticMilli(current.D),
      AppMotorControl_DiagnosticMilli(app_hard_stop_current_a),
      AppMotorControl_DiagnosticMilli(app_tb200s_load_setpoint_a),
      (unsigned long)MC_GetCurrentFaultsMotor1(),
      (unsigned long)MC_GetOccurredFaultsMotor1());
    app_fault_report_pending = true;
    AppFaultDiag_PrepareReport();
  }
  app_mc_fault_reason = reason;
  app_mc_state = APP_MC_FAULT;
}

static void AppMotorControl_TripFault(const char *reason)
{
  AppMotorControl_SetFault(reason);
  AppMotorControl_Stop();
  app_button_toggle_pending = false;
  app_mc_state = APP_MC_FAULT;
  AppMotorControl_ReportPendingFault();
}

static void AppMotorControl_ResetId(void)
{
  app_active_id_a = 0.0f;
  app_id_ramp_last_ms = 0U;
  app_id_speed_stable_since_ms = 0U;
  app_id_speed_stable = false;
  if ((pMCI[M1] != NULL) && (pMCI[M1]->pSTC != NULL))
  {
    MCI_SetIdRef(pMCI[M1], FIXP16(0.0f));
  }
}

static void AppMotorControl_TripTemperatureFault(const char *reason)
{
  app_thermal_latched = true;
  AppMotorControl_TripFault(reason);
}

static bool AppMotorControl_CheckTemperature(bool allow_rearm)
{
  float temperature_c;

  if (!D6TIR_GetFreshTemperatureC(&temperature_c, APP_MOTOR_D6T_MAX_AGE_MS) ||
      !AppMotorControl_IsFiniteFloat(temperature_c))
  {
    AppMotorControl_TripTemperatureFault("D6T_UNAVAILABLE");
    return false;
  }
  if (temperature_c > APP_MOTOR_OVERTEMP_C)
  {
    AppMotorControl_TripTemperatureFault("D6T_OVERTEMP");
    return false;
  }
  if (app_thermal_latched)
  {
    if (!allow_rearm || (temperature_c > APP_MOTOR_RESTART_TEMP_C))
    {
      AppMotorControl_TripFault(app_mc_fault_reason);
      return false;
    }
    /* Only a new START / PROFILE / B2 action may clear this latch. */
    app_thermal_latched = false;
  }
  return true;
}

static float AppMotorControl_MechRpmToElecHz(float rpm)
{
  return (rpm * (float)POLE_PAIR_NUM) / 60.0f;
}

static uint32_t AppMotorControl_ButtonRandomNext(void)
{
  uint32_t random_value = app_button_random_state;

  random_value ^= random_value << 13;
  random_value ^= random_value >> 17;
  random_value ^= random_value << 5;
  app_button_random_state = random_value;
  return random_value;
}

static void AppMotorControl_ReseedRandom(uint32_t now)
{
  app_button_random_state ^= now + 0x9E3779B9U;
  if (app_button_random_state == 0U)
  {
    app_button_random_state = 0x6D2B79F5U;
  }

  (void)AppMotorControl_ButtonRandomNext();
}

static uint32_t AppMotorControl_ButtonRandomRange(uint32_t minimum,
                                                   uint32_t maximum)
{
  uint32_t range = (maximum - minimum) + 1U;
  uint32_t rejection_threshold = (uint32_t)(0U - range) % range;
  uint32_t random_value;

  /* Rejection sampling removes modulo bias when the range size does not
   * divide the PRNG's 2^32 possible values exactly. */
  do
  {
    random_value = AppMotorControl_ButtonRandomNext();
  } while (random_value < rejection_threshold);

  return minimum + (random_value % range);
}

static uint32_t AppMotorControl_LoadToDacCode(float load_a)
{
  float dac_voltage_v = APP_TB200S_CAL_LOW_V +
    ((load_a - APP_TB200S_CAL_LOW_A) *
     ((APP_TB200S_CAL_HIGH_V - APP_TB200S_CAL_LOW_V) /
      (APP_TB200S_CAL_HIGH_A - APP_TB200S_CAL_LOW_A)));
  float code = (dac_voltage_v / APP_TB200S_DAC_VREF_V) *
    (float)APP_TB200S_DAC_MAX_CODE;

  if (code <= 0.0f)
  {
    return 0U;
  }
  if (code >= (float)APP_TB200S_DAC_MAX_CODE)
  {
    return APP_TB200S_DAC_MAX_CODE;
  }
  return (uint32_t)(code + 0.5f);
}

static bool AppMotorControl_ApplyLoadSetpoint(float load_a)
{
  uint32_t dac_code = AppMotorControl_LoadToDacCode(load_a);

  if (HAL_DAC_SetValue(&hdac1,
                       DAC_CHANNEL_2,
                       DAC_ALIGN_12B_R,
                       dac_code) != HAL_OK)
  {
    return false;
  }

  app_tb200s_load_setpoint_a = load_a;
  return true;
}

static void AppMotorControl_ScheduleNextLoadChange(uint32_t now)
{
  uint32_t delay_ms = AppMotorControl_ButtonRandomRange(
    APP_TB200S_MIN_CHANGE_PERIOD_MS,
    APP_TB200S_MAX_CHANGE_PERIOD_MS);

  app_tb200s_next_change_ms = now + delay_ms;
  app_tb200s_change_scheduled = true;
}

static bool AppMotorControl_SelectAndApplyNextLoad(void)
{
  uint32_t current_ma = (uint32_t)((app_tb200s_load_setpoint_a * 1000.0f) + 0.5f);
  uint32_t next_ma;

  do
  {
    next_ma = AppMotorControl_ButtonRandomRange(
      (uint32_t)(APP_TB200S_VARIABLE_MIN_LOAD_A * 1000.0f),
      (uint32_t)(APP_TB200S_VARIABLE_MAX_LOAD_A * 1000.0f));
  } while (next_ma == current_ma);

  return AppMotorControl_ApplyLoadSetpoint((float)next_ma / 1000.0f);
}

static bool AppMotorControl_PrepareLoadForMotorStart(void)
{
  app_tb200s_change_scheduled = false;
  app_tb200s_next_change_ms = 0U;
  return AppMotorControl_ApplyLoadSetpoint(APP_TB200S_MIN_LOAD_A);
}

static bool AppMotorControl_OnMotorRunning(uint32_t now)
{
  app_tb200s_change_scheduled = false;
  app_tb200s_next_change_ms = 0U;

  if (AppMotorControl_IsCustomStartActive())
  {
    app_custom_last_ms = now;
    return AppMotorControl_ApplyLoadSetpoint(APP_TB200S_MIN_LOAD_A);
  }

  if (app_tb200s_load_mode == APP_TB200S_LOAD_VARIABLE)
  {
    if (!AppMotorControl_ApplyLoadSetpoint(APP_TB200S_MIN_LOAD_A))
    {
      return false;
    }
    AppMotorControl_ScheduleNextLoadChange(now);
    return true;
  }

  return AppMotorControl_ApplyLoadSetpoint(app_tb200s_requested_load_a);
}

static void AppMotorControl_OnMotorStopped(void)
{
  AppMotorControl_ResetCustomStart();
  AppMotorControl_ResetId();
  app_tb200s_change_scheduled = false;
  app_tb200s_next_change_ms = 0U;
  (void)AppMotorControl_ApplyLoadSetpoint(APP_TB200S_MIN_LOAD_A);
}

static bool AppMotorControl_ServiceVariableLoad(uint32_t now)
{
  if (AppMotorControl_IsCustomStartActive())
  {
    return true;
  }

  if (app_tb200s_load_mode != APP_TB200S_LOAD_VARIABLE)
  {
    return true;
  }

  if (!app_tb200s_change_scheduled)
  {
    AppMotorControl_ScheduleNextLoadChange(now);
    return true;
  }

  if ((int32_t)(now - app_tb200s_next_change_ms) < 0)
  {
    return true;
  }

  if (!AppMotorControl_SelectAndApplyNextLoad())
  {
    return false;
  }

  AppMotorControl_ScheduleNextLoadChange(now);
  return true;
}

bool AppMotorControl_SetLoadFixed(float load_a)
{
  if (!AppMotorControl_IsFiniteFloat(load_a) ||
      (load_a < APP_TB200S_MIN_LOAD_A) ||
      (load_a > APP_TB200S_MAX_LOAD_A))
  {
    return false;
  }

  app_tb200s_load_mode = APP_TB200S_LOAD_FIXED;
  app_tb200s_requested_load_a = load_a;
  app_tb200s_change_scheduled = false;
  app_tb200s_next_change_ms = 0U;

  /* A LOAD received during Custom startup cannot bypass the brake ramp.
   * Subsequent increases also wait for stable speed and use the same ramp. */
  if ((app_mc_state == APP_MC_RUNNING) &&
      (app_custom_phase != APP_CUSTOM_OFF))
  {
    if ((app_custom_phase == APP_CUSTOM_DONE) &&
        (load_a > app_tb200s_load_setpoint_a))
    {
      app_custom_phase = APP_CUSTOM_FINAL_SPEED;
      app_custom_last_ms = HAL_GetTick();
      app_custom_speed_stable = false;
      app_custom_speed_unstable = false;
    }
    if (AppMotorControl_IsCustomStartActive())
    {
      return AppMotorControl_ApplyLoadSetpoint(
        fminf(app_tb200s_load_setpoint_a, load_a));
    }
  }

  /* Outside RUN, enforce 0.05 A so that the next start can never occur
   * under a higher load. */
  return AppMotorControl_ApplyLoadSetpoint(
    (app_mc_state == APP_MC_RUNNING) ? load_a : APP_TB200S_MIN_LOAD_A);
}

bool AppMotorControl_SetLoadVariable(void)
{
  uint32_t now = HAL_GetTick();

  AppMotorControl_ReseedRandom(now);
  app_tb200s_load_mode = APP_TB200S_LOAD_VARIABLE;
  app_tb200s_requested_load_a = APP_TB200S_MIN_LOAD_A;
  app_tb200s_change_scheduled = false;
  app_tb200s_next_change_ms = 0U;

  if (!AppMotorControl_ApplyLoadSetpoint(APP_TB200S_MIN_LOAD_A))
  {
    return false;
  }

  if ((app_mc_state == APP_MC_RUNNING) &&
      !AppMotorControl_IsCustomStartActive())
  {
    AppMotorControl_ScheduleNextLoadChange(now);
  }
  return true;
}

float AppMotorControl_GetLoadSetpointA(void)
{
  return app_tb200s_load_setpoint_a;
}

static void AppMotorControl_ScheduleNextButtonSpeedChange(uint32_t now)
{
  uint32_t delay_ms = AppMotorControl_ButtonRandomRange(
    APP_BUTTON_MIN_CHANGE_PERIOD_MS,
    APP_BUTTON_MAX_CHANGE_PERIOD_MS);

  app_button_next_speed_change_ms = now + delay_ms;
  app_button_speed_change_scheduled = true;
}

static float AppMotorControl_SelectNextButtonSpeed(void)
{
  uint32_t next_speed_rpm;

  /* Draw each target directly from the entire range, without small steps.
   * Exclude the current target to guarantee an actual change. */
  do
  {
    next_speed_rpm = AppMotorControl_ButtonRandomRange(
      (uint32_t)APP_BUTTON_MIN_TARGET_SPEED_RPM,
      (uint32_t)APP_BUTTON_MAX_TARGET_SPEED_RPM);
  } while ((float)next_speed_rpm == app_target_speed_rpm);

  return (float)next_speed_rpm;
}

static void AppMotorControl_SetButtonProfileConfig(float target_speed_rpm)
{
  app_target_speed_rpm = target_speed_rpm;
  app_iq_limit_a = APP_BUTTON_IQ_LIMIT_A;
  app_hard_stop_current_a = APP_BUTTON_HARD_STOP_CURRENT_A;
}

static bool AppMotorControl_ConfigureProfile(AppMotorProfile_t profile,
                                             uint32_t now)
{
  float initial_speed_rpm;
  bool variable_speed;
  bool variable_load;

  if ((uint32_t)profile >= (uint32_t)APP_MOTOR_PROFILE_COUNT)
  {
    return false;
  }

  variable_speed = (profile == APP_MOTOR_PROFILE_VARIABLE_SPEED) ||
                   (profile == APP_MOTOR_PROFILE_VARIABLE_ALL);
  variable_load = (profile == APP_MOTOR_PROFILE_VARIABLE_LOAD) ||
                  (profile == APP_MOTOR_PROFILE_VARIABLE_ALL);

  AppMotorControl_ReseedRandom(now);
  app_button_profile_active = true;
  app_button_speed_variable = variable_speed;
  app_button_speed_change_scheduled = false;
  app_button_next_speed_change_ms = 0U;

  /* Each profile explicitly overrides a previous LOAD command. This ensures
   * that B2 always restarts VARIABLE_ALL, regardless of the serial command
   * history. */
  app_tb200s_load_mode = variable_load
    ? APP_TB200S_LOAD_VARIABLE
    : APP_TB200S_LOAD_FIXED;
  app_tb200s_requested_load_a = variable_load
    ? APP_TB200S_MIN_LOAD_A
    : APP_PROFILE_FIXED_LOAD_A;
  app_tb200s_change_scheduled = false;
  app_tb200s_next_change_ms = 0U;

  if (!AppMotorControl_ApplyLoadSetpoint(APP_TB200S_MIN_LOAD_A))
  {
    app_button_profile_active = false;
    app_button_speed_variable = false;
    app_tb200s_load_mode = APP_TB200S_LOAD_FIXED;
    app_tb200s_requested_load_a = APP_TB200S_MIN_LOAD_A;
    return false;
  }

  initial_speed_rpm = variable_speed
    ? AppMotorControl_SelectNextButtonSpeed()
    : APP_PROFILE_FIXED_SPEED_RPM;
  AppMotorControl_SetButtonProfileConfig(initial_speed_rpm);
  return true;
}

static void AppMotorControl_StopButtonProfile(void)
{
  app_button_profile_active = false;
  app_button_speed_variable = false;
  app_button_speed_change_scheduled = false;
  app_button_next_speed_change_ms = 0U;
}

static void AppMotorControl_ServiceButtonProfile(uint32_t now)
{
  if (!app_button_profile_active ||
      !app_button_speed_variable ||
      (app_mc_state != APP_MC_RUNNING))
  {
    return;
  }

  if (!app_button_speed_change_scheduled)
  {
    AppMotorControl_ScheduleNextButtonSpeedChange(now);
    return;
  }

  if ((int32_t)(now - app_button_next_speed_change_ms) < 0)
  {
    return;
  }

  app_target_speed_rpm = AppMotorControl_SelectNextButtonSpeed();
  app_mc_overspeed_since_ms = 0U;
  AppMotorControl_ApplySpeedReference();
  AppMotorControl_ScheduleNextButtonSpeedChange(now);
}

static void AppMotorControl_ResetSpeedPi(void)
{
  if ((pMCI[M1] != NULL) && (pMCI[M1]->pSTC != NULL))
  {
    PIDREG_SPEED_setUi_pu(&pMCI[M1]->pSTC->PIDSpeed, FIXP30(0.0f));
  }
}

static void AppMotorControl_SetIqLimit(float limit_a, bool reset_pi)
{
  float total_limit_a;

  if (limit_a <= 0.0f)
  {
    limit_a = APP_DEFAULT_IQ_LIMIT_A;
  }

  if (limit_a > APP_MOTOR_MAX_IQ_LIMIT_A)
  {
    limit_a = APP_MOTOR_MAX_IQ_LIMIT_A;
  }

  /* B2 ramps Iq smoothly and gradually raises the Id/Iq current circle to 30 A;
   * at steady state, Iq remains independently capped at 28 A. */
  total_limit_a = limit_a;
  if (app_button_profile_active)
  {
    total_limit_a += APP_BUTTON_HARD_STOP_CURRENT_A - APP_BUTTON_IQ_LIMIT_A;
    if (total_limit_a > APP_BUTTON_HARD_STOP_CURRENT_A)
    {
      total_limit_a = APP_BUTTON_HARD_STOP_CURRENT_A;
    }
  }

  if (app_active_id_a > 0.0f)
  {
    /* Preserve the Iq budget where possible, without raising a safety ceiling. */
    float vector_limit_a = sqrtf((limit_a * limit_a) +
                                 (app_active_id_a * app_active_id_a));
    if (vector_limit_a > total_limit_a)
    {
      total_limit_a = vector_limit_a;
    }
    if (total_limit_a > app_hard_stop_current_a)
    {
      total_limit_a = app_hard_stop_current_a;
    }
    if (total_limit_a > APP_MOTOR_MAX_TOTAL_CURRENT_A)
    {
      total_limit_a = APP_MOTOR_MAX_TOTAL_CURRENT_A;
    }
  }
  MCI_SetMaxCurrent(pMCI[M1], FIXP16(total_limit_a));

  /*
   * In MCSDK HSO, MCI_SetMaxCurrent() updates I_max_pu but does not necessarily
   * update the speed PI's internal limits. If these limits still differ from
   * NOMINAL_CURRENT_A=30 A, the PI may integrate too aggressively and request
   * 6-8 A at once. Therefore, force the PI limit to match the runtime Iq limit.
   */
  if ((pMCI[M1] != NULL) && (pMCI[M1]->pSTC != NULL))
  {
    fixp30_t limit_pu = FIXP30(limit_a / CURRENT_SCALE);
    PIDREG_SPEED_setOutputLimits(&pMCI[M1]->pSTC->PIDSpeed, limit_pu, -limit_pu);

    if (reset_pi)
    {
      PIDREG_SPEED_setUi_pu(&pMCI[M1]->pSTC->PIDSpeed, FIXP30(0.0f));
    }
  }
}

static void AppMotorControl_UpdateIdReference(uint32_t now, float measured_iq_a)
{
  /* Keep the heating current out of the speed/brake startup sequence. */
  if (AppMotorControl_IsCustomStartActive())
  {
    AppMotorControl_ResetId();
    app_id_ramp_last_ms = now;
    AppMotorControl_SetIqLimit(app_active_iq_limit_a, false);
    return;
  }

  float target_a = APP_ID_TARGET_A;
  float total_cap_a = fminf(app_hard_stop_current_a, APP_MOTOR_MAX_TOTAL_CURRENT_A);
  float remaining_a2 = (total_cap_a * total_cap_a) -
                       (measured_iq_a * measured_iq_a);
  float available_id_a = sqrtf(fmaxf(remaining_a2, 0.0f));
  float speed_rpm = (MC_GetSpeedMotor1_F() * 60.0f) / (float)POLE_PAIR_NUM;
  float tolerance_rpm = fmaxf(APP_ID_MIN_SPEED_TOLERANCE_RPM,
                             app_target_speed_rpm * APP_ID_SPEED_TOLERANCE_RATIO);
  uint32_t dt_ms = now - app_id_ramp_last_ms;
  app_id_ramp_last_ms = now;

  if (!AppMotorControl_IsFiniteFloat(target_a) || (target_a < 0.0f))
  {
    target_a = 0.0f;
  }
  target_a = fminf(target_a, available_id_a);
  if (app_active_id_a > target_a)
  {
    app_active_id_a = target_a;
  }

  if (!AppMotorControl_IsFiniteFloat(speed_rpm) ||
      (fabsf(speed_rpm - app_target_speed_rpm) > tolerance_rpm))
  {
    app_id_speed_stable = false;
  }
  else
  {
    if (!app_id_speed_stable)
    {
      app_id_speed_stable = true;
      app_id_speed_stable_since_ms = now;
    }
    uint32_t stable_ms = now - app_id_speed_stable_since_ms;
    if (stable_ms > APP_ID_SPEED_STABLE_MS)
    {
      uint32_t ramp_ms = stable_ms - APP_ID_SPEED_STABLE_MS;
      if (dt_ms > ramp_ms) dt_ms = ramp_ms;
      /* A delayed main-loop iteration must not cause a large current step. */
      if (dt_ms > 100U) dt_ms = 100U;
      app_active_id_a = fminf(target_a, app_active_id_a +
        (APP_ID_RAMP_A_PER_S * ((float)dt_ms / 1000.0f)));
    }
  }

  AppMotorControl_SetIqLimit(app_active_iq_limit_a, false);
  MCI_SetIdRef(pMCI[M1], FIXP16(app_active_id_a));
}

static void AppMotorControl_ApplySpeedPidTuning(void)
{
  MCI_SetPidSpeedKp(pMCI[M1], PID_SPD_KP * APP_SPEED_PID_KP_FACTOR);
  MCI_SetPidSpeedKi(pMCI[M1], PID_SPD_KI * APP_SPEED_PID_KI_FACTOR);
}

static void AppMotorControl_ApplySpeedReference(void)
{
  float accel_elec_hz_s = app_button_profile_active
    ? APP_BUTTON_ACCEL_ELEC_HZ_S
    : app_accel_elec_hz_s;

  float speed_ref_rpm = app_target_speed_rpm;
  if (app_custom_phase != APP_CUSTOM_OFF)
  {
    speed_ref_rpm = app_custom_speed_ref_rpm;
    if (app_custom_phase == APP_CUSTOM_INITIAL_SPEED)
    {
      accel_elec_hz_s = APP_CUSTOM_START_ACCEL_ELEC_HZ_S;
    }
    else if (app_custom_phase == APP_CUSTOM_SPEED_RAMP)
    {
      accel_elec_hz_s = fminf(accel_elec_hz_s,
        AppMotorControl_MechRpmToElecHz(APP_CUSTOM_SPEED_RAMP_RPM_PER_S));
    }
  }

  MC_SetAccelerationMotor1_F(accel_elec_hz_s);
  MC_SetSpeedReferenceMotor1_F(
    AppMotorControl_MechRpmToElecHz(speed_ref_rpm));
}

static bool AppMotorControl_AbortCustomStart(const char *reason)
{
  AppMotorControl_TripFault(reason);
  return false;
}

static void AppMotorControl_CompleteCustomStart(uint32_t now)
{
  app_custom_phase = APP_CUSTOM_DONE;
  if (app_tb200s_load_mode == APP_TB200S_LOAD_VARIABLE)
  {
    AppMotorControl_ScheduleNextLoadChange(now);
  }
  (void)AppDatalog_SendText("#CUSTOM,READY\r\n");
}

static bool AppMotorControl_ServiceCustomStart(uint32_t now)
{
  if (!AppMotorControl_IsCustomStartActive())
  {
    return true;
  }
  if (MC_GetSTMStateMotor1() != RUN)
  {
    return AppMotorControl_AbortCustomStart("CUSTOM_MOTOR_STOPPED");
  }

  uint32_t dt_ms = now - app_custom_last_ms;
  app_custom_last_ms = now;
  /* Never catch up a delayed loop with a large speed or brake step. */
  if (dt_ms > 100U) dt_ms = 100U;

  float speed_rpm = (MC_GetSpeedMotor1_F() * 60.0f) / (float)POLE_PAIR_NUM;
  if (!AppMotorControl_IsFiniteFloat(speed_rpm))
  {
    return AppMotorControl_AbortCustomStart("NONFINITE_SPEED");
  }
  float tolerance_rpm = fmaxf(APP_CUSTOM_MIN_SPEED_TOLERANCE_RPM,
    app_custom_speed_ref_rpm * APP_CUSTOM_SPEED_TOLERANCE_RATIO);
  bool tracking_speed = fabsf(speed_rpm - app_custom_speed_ref_rpm) <= tolerance_rpm;
  if (!tracking_speed)
  {
    app_custom_speed_stable = false;
    if (!app_custom_speed_unstable)
    {
      app_custom_speed_unstable = true;
      app_custom_unstable_since_ms = now;
    }
    if ((now - app_custom_unstable_since_ms) >= APP_CUSTOM_SPEED_TIMEOUT_MS)
    {
      return AppMotorControl_AbortCustomStart("CUSTOM_SPEED_TIMEOUT");
    }
  }
  else
  {
    app_custom_speed_unstable = false;
    if (!app_custom_speed_stable)
    {
      app_custom_speed_stable = true;
      app_custom_stable_since_ms = now;
    }
  }
  uint32_t stable_ms = app_custom_speed_stable
    ? now - app_custom_stable_since_ms : 0U;

  switch (app_custom_phase)
  {
    case APP_CUSTOM_INITIAL_SPEED:
      if (tracking_speed && (stable_ms >= APP_CUSTOM_START_STABLE_MS))
      {
        app_custom_phase = (app_custom_speed_ref_rpm == app_target_speed_rpm)
          ? APP_CUSTOM_FINAL_SPEED : APP_CUSTOM_SPEED_RAMP;
        AppMotorControl_ApplySpeedReference();
      }
      break;

    case APP_CUSTOM_SPEED_RAMP:
      if (tracking_speed)
      {
        float rate_rpm_s = fminf(APP_CUSTOM_SPEED_RAMP_RPM_PER_S,
          app_accel_elec_hz_s * 60.0f / (float)POLE_PAIR_NUM);
        float step_rpm = rate_rpm_s * ((float)dt_ms / 1000.0f);
        if (app_custom_speed_ref_rpm < app_target_speed_rpm)
        {
          app_custom_speed_ref_rpm = fminf(app_target_speed_rpm,
            app_custom_speed_ref_rpm + step_rpm);
        }
        else
        {
          app_custom_speed_ref_rpm = fmaxf(app_target_speed_rpm,
            app_custom_speed_ref_rpm - step_rpm);
        }
        AppMotorControl_ApplySpeedReference();
        if (app_custom_speed_ref_rpm == app_target_speed_rpm)
        {
          app_custom_phase = APP_CUSTOM_FINAL_SPEED;
          app_custom_speed_stable = false;
        }
      }
      break;

    case APP_CUSTOM_FINAL_SPEED:
      if (tracking_speed && (stable_ms >= APP_CUSTOM_TARGET_STABLE_MS))
      {
        app_custom_phase = APP_CUSTOM_LOAD_RAMP;
      }
      break;

    case APP_CUSTOM_LOAD_RAMP:
      /* If speed drops, hold the brake at its current value. Require a
       * full stability interval before increasing it again. */
      if (tracking_speed && (stable_ms >= APP_CUSTOM_TARGET_STABLE_MS))
      {
        if (app_tb200s_load_mode == APP_TB200S_LOAD_VARIABLE)
        {
          AppMotorControl_CompleteCustomStart(now);
          break;
        }
        uint32_t ramp_ms = stable_ms - APP_CUSTOM_TARGET_STABLE_MS;
        if (dt_ms > ramp_ms) dt_ms = ramp_ms;
        float next_a = fminf(app_tb200s_requested_load_a,
          app_tb200s_load_setpoint_a +
          APP_CUSTOM_LOAD_RAMP_A_PER_S * ((float)dt_ms / 1000.0f));
        if (!AppMotorControl_ApplyLoadSetpoint(next_a))
        {
          return AppMotorControl_AbortCustomStart("LOAD_DAC");
        }
        if (next_a >= app_tb200s_requested_load_a)
        {
          AppMotorControl_CompleteCustomStart(now);
        }
      }
      break;

    default:
      break;
  }
  return true;
}

static float AppMotorControl_GetOverspeedReferenceRpm(void)
{
  float reference_rpm = (app_custom_phase != APP_CUSTOM_OFF)
    ? app_custom_speed_ref_rpm : app_target_speed_rpm;

  /* During a downward B2 transition, speed cannot instantly track the final
   * target. The envelope therefore follows the internal setpoint actually
   * ramped by MCSDK, without changing the absolute ceiling. */
  if (app_button_profile_active &&
      (pMCI[M1] != NULL) &&
      (pMCI[M1]->pSTC != NULL))
  {
    float ramped_elec_hz = FIXP30_toF(pMCI[M1]->pSTC->speed_ref_ramped_pu)
      * FREQUENCY_SCALE;
    float ramped_rpm = fabsf((ramped_elec_hz * 60.0f) / (float)POLE_PAIR_NUM);

    if (AppMotorControl_IsFiniteFloat(ramped_rpm) &&
        (ramped_rpm > reference_rpm))
    {
      reference_rpm = ramped_rpm;
    }
  }

  return reference_rpm;
}

static void AppMotorControl_ApplyConfig(void)
{
  AppMotorControl_ApplySpeedPidTuning();
  AppMotorControl_SetIqLimit(app_active_iq_limit_a, true);

  MC_SetControlModeMotor1(MCM_SPEED_MODE);
  AppMotorControl_ApplySpeedReference();
}

void AppMotorControl_SetRuntimeConfig(float target_rpm,
                                      float iq_limit_a,
                                      float hard_limit_a,
                                      float accel_elec_hz_s)
{
  float previous_ref_rpm = (app_custom_phase != APP_CUSTOM_OFF)
    ? app_custom_speed_ref_rpm : app_target_speed_rpm;
  AppMotorControl_ResetCustomStart();
  AppMotorControl_ResetId();
  /* An external configuration explicitly takes control back from B2. */
  AppMotorControl_StopButtonProfile();

  if (!AppMotorControl_IsFiniteFloat(target_rpm))
  {
    target_rpm = APP_DEFAULT_TARGET_SPEED_RPM;
  }
  else if (target_rpm < APP_CFG_MIN_TARGET_SPEED_RPM)
  {
    target_rpm = APP_CFG_MIN_TARGET_SPEED_RPM;
  }
  else if (target_rpm > APP_MOTOR_MAX_TARGET_SPEED_RPM)
  {
    target_rpm = APP_MOTOR_MAX_TARGET_SPEED_RPM;
  }
  app_target_speed_rpm = target_rpm;

  if (!AppMotorControl_IsFiniteFloat(iq_limit_a) || (iq_limit_a <= 0.0f))
  {
    iq_limit_a = APP_DEFAULT_IQ_LIMIT_A;
  }
  else if (iq_limit_a > APP_MOTOR_MAX_IQ_LIMIT_A)
  {
    iq_limit_a = APP_MOTOR_MAX_IQ_LIMIT_A;
  }
  app_iq_limit_a = iq_limit_a;

  if (!AppMotorControl_IsFiniteFloat(hard_limit_a) || (hard_limit_a <= 0.0f))
  {
    hard_limit_a = APP_DEFAULT_HARD_STOP_CURRENT_A;
  }
  else if (hard_limit_a > APP_MOTOR_MAX_TOTAL_CURRENT_A)
  {
    hard_limit_a = APP_MOTOR_MAX_TOTAL_CURRENT_A;
  }
  app_hard_stop_current_a = hard_limit_a;

  if (!AppMotorControl_IsFiniteFloat(accel_elec_hz_s) ||
      (accel_elec_hz_s <= 0.0f))
  {
    accel_elec_hz_s = APP_DEFAULT_ACCEL_ELEC_HZ_S;
  }
  else if (accel_elec_hz_s > APP_CFG_MAX_ACCEL_ELEC_HZ_S)
  {
    accel_elec_hz_s = APP_CFG_MAX_ACCEL_ELEC_HZ_S;
  }
  app_accel_elec_hz_s = accel_elec_hz_s;

  /* Reconfiguration during STARTING/RUN restarts the staged sequence from
   * the current reference, avoiding a speed step or a full brake load. */
  if ((app_mc_state == APP_MC_RUNNING) || (app_mc_state == APP_MC_STARTING))
  {
    AppMotorControl_BeginCustomStart(previous_ref_rpm);
    if (!AppMotorControl_ApplyLoadSetpoint(APP_TB200S_MIN_LOAD_A))
    {
      (void)AppMotorControl_AbortCustomStart("LOAD_DAC");
      return;
    }
  }

  /*
   * If parameters are changed during RUN, this line applies the new
   * setpoint directly.
   */
  if ((app_mc_state == APP_MC_RUNNING) || (app_mc_state == APP_MC_STARTING))
  {
    /* During RUN, do not jump abruptly to a higher current limit. */
    if (app_active_iq_limit_a > app_iq_limit_a)
    {
      app_active_iq_limit_a = app_iq_limit_a;
    }

    AppMotorControl_ApplyConfig();
  }
}

void AppMotorControl_Init(void)
{
  app_fault_report_pending = false;
  app_mc_fault_reason = "NONE";
  AppMotorControl_ResetCustomStart();
  AppMotorControl_ResetId();
  app_thermal_latched = false;
  app_tb200s_load_mode = APP_TB200S_LOAD_FIXED;
  app_tb200s_requested_load_a = APP_TB200S_MIN_LOAD_A;
  app_tb200s_load_setpoint_a = APP_TB200S_MIN_LOAD_A;
  app_tb200s_change_scheduled = false;
  app_tb200s_next_change_ms = 0U;
  if ((HAL_DAC_Start(&hdac1, DAC_CHANNEL_2) != HAL_OK) ||
      !AppMotorControl_ApplyLoadSetpoint(APP_TB200S_MIN_LOAD_A))
  {
    Error_Handler();
  }

  app_mc_boot_ms = HAL_GetTick();
  app_motor_start_requested = false;
  app_motor_next_start_attempt_ms = 0U;
  AppMotorControl_StopButtonProfile();

#if APP_MOTOR_AUTOSTART_ENABLE
  app_mc_state = APP_MC_WAIT_AUTOSTART;
#else
  app_mc_state = APP_MC_IDLE;
#endif
}

bool AppMotorControl_Start(void)
{
  if (!AppMotorControl_CheckTemperature(true))
  {
    return false;
  }
  MCI_State_t state = MC_GetSTMStateMotor1();

  if (state == FAULT_OVER)
  {
    MC_AcknowledgeFaultsMotor1();
  }

  if (MC_GetCurrentFaultsMotor1() != MC_NO_FAULTS)
  {
    AppMotorControl_TripFault("MCSDK_FAULT");
    return false;
  }

  state = MC_GetSTMStateMotor1();

  if (state != IDLE)
  {
    AppMotorControl_TripFault("MCSDK_NOT_IDLE");
    return false;
  }

  /* Write the minimum load before any MCSDK polarization/startup.
   * Custom keeps it until speed is stable, then ramps the requested load. */
  if (!AppMotorControl_PrepareLoadForMotorStart())
  {
    AppMotorControl_TripFault("LOAD_DAC");
    return false;
  }

  AppMotorControl_ResetId();
  AppMotorControl_ResetCustomStart();
  if (!app_button_profile_active)
  {
    AppMotorControl_BeginCustomStart(
      fminf(app_target_speed_rpm, APP_CUSTOM_START_SPEED_RPM));
  }
  app_active_iq_limit_a = app_iq_limit_a;
  if (app_active_iq_limit_a > APP_IQ_START_LIMIT_A)
  {
    app_active_iq_limit_a = APP_IQ_START_LIMIT_A;
  }
  app_iq_ramp_last_ms = HAL_GetTick();

  AppMotorControl_ApplyConfig();
  AppFaultDiag_Arm();
  AppFocTiming_Arm();

  if (MC_StartWithPolarizationMotor1() == MC_SUCCESS)
  {
    app_motor_start_requested = false;
    app_mc_fault_reason = "NONE";
    app_mc_state = APP_MC_STARTING;
    app_mc_start_ms = HAL_GetTick();
    AppMotorControl_ResetSpeedPi();
    app_mc_overcurrent_since_ms = 0U;
    app_mc_overspeed_since_ms = 0U;
    if (AppMotorControl_IsCustomStartActive())
    {
      (void)AppDatalog_SendText("#CUSTOM,START\r\n");
    }
    return true;
  }

  AppMotorControl_TripFault("START_REJECTED");
  return false;
}

void AppMotorControl_Stop(void)
{
  app_motor_start_requested = false;
  AppMotorControl_StopButtonProfile();
  MC_StopMotor1();
  /* MC_StopMotor does not cancel a start still queued while MCSDK is IDLE. */
  if (pMCI[M1] != NULL)
  {
    pMCI[M1]->DirectCommand = MCI_STOP;
  }
  AppMotorControl_OnMotorStopped();

  app_mc_state = APP_MC_IDLE;
  app_mc_start_ms = 0U;
  app_mc_run_enter_ms = 0U;
  app_iq_ramp_last_ms = 0U;
  app_active_iq_limit_a = APP_DEFAULT_IQ_LIMIT_A;
  app_mc_overcurrent_since_ms = 0U;
  app_mc_overspeed_since_ms = 0U;
}

AppMotorProfileStartResult_t AppMotorControl_StartProfile(
  AppMotorProfile_t profile)
{
  uint32_t now;
  MCI_State_t mc_state;

  if ((uint32_t)profile >= (uint32_t)APP_MOTOR_PROFILE_COUNT)
  {
    return APP_MOTOR_PROFILE_START_INVALID;
  }

  /* A new selection cleanly replaces the previous profile. The MCSDK stop
   * call is asynchronous, so the start request below waits for IDLE in
   * AppMotorControl_ServiceStartRequest(). */
  mc_state = MC_GetSTMStateMotor1();
  if (app_motor_start_requested ||
      app_button_profile_active ||
      (app_mc_state != APP_MC_IDLE) ||
      (mc_state != IDLE))
  {
    AppMotorControl_Stop();
  }
  else
  {
    AppMotorControl_StopButtonProfile();
  }

  if (!AppMotorControl_CheckTemperature(true))
  {
    return APP_MOTOR_PROFILE_START_THERMAL_ERROR;
  }
  now = HAL_GetTick();
  if (!AppMotorControl_ConfigureProfile(profile, now))
  {
    app_motor_start_requested = false;
    AppMotorControl_OnMotorStopped();
    return APP_MOTOR_PROFILE_START_LOAD_ERROR;
  }

  app_motor_start_requested = true;
  app_motor_next_start_attempt_ms = 0U;
  return APP_MOTOR_PROFILE_START_ACCEPTED;
}

bool AppMotorControl_IsRunning(void)
{
  return (app_mc_state == APP_MC_RUNNING) || (MC_GetSTMStateMotor1() == RUN);
}

bool AppMotorControl_IsActive(void)
{
  return app_motor_start_requested || (app_mc_state == APP_MC_STARTING) ||
         AppMotorControl_IsRunning();
}

/* Override the weak implementation generated in mc_tasks.c. This function is
 * called from EXTI15_10_IRQHandler() and must therefore remain nonblocking. */
void UI_HandleStartStopButton_cb(void)
{
  uint32_t now = HAL_GetTick();

  if ((!app_button_irq_seen) ||
      ((now - app_button_last_irq_ms) >= APP_BUTTON_DEBOUNCE_MS))
  {
    app_button_toggle_pending = true;
    app_button_last_irq_ms = now;
    app_button_irq_seen = true;
  }
}

static bool AppMotorControl_TakeButtonToggleRequest(void)
{
  bool pending;
  uint32_t primask = __get_PRIMASK();

  __disable_irq();
  pending = app_button_toggle_pending;
  app_button_toggle_pending = false;

  if (primask == 0U)
  {
    __enable_irq();
  }

  return pending;
}

static void AppMotorControl_HandleButtonToggle(void)
{
  if (!AppMotorControl_TakeButtonToggleRequest())
  {
    return;
  }

  if (app_button_profile_active ||
      app_motor_start_requested ||
      (app_mc_state == APP_MC_STARTING) ||
      AppMotorControl_IsRunning())
  {
    AppMotorControl_Stop();
    return;
  }

  /* B2 deliberately uses a deterministic profile selection: it overrides any
   * previous LOAD/PROFILE command and always starts the variable speed and
   * load profile. */
  (void)AppMotorControl_StartProfile(APP_MOTOR_PROFILE_VARIABLE_ALL);
}

static void AppMotorControl_ServiceStartRequest(uint32_t now,
                                                uint32_t current_faults,
                                                MCI_State_t mc_state)
{
  if (!app_motor_start_requested)
  {
    return;
  }

  if (mc_state == FAULT_OVER)
  {
    MC_AcknowledgeFaultsMotor1();
    app_motor_next_start_attempt_ms = now + APP_START_RETRY_PERIOD_MS;
    return;
  }

  if ((current_faults != MC_NO_FAULTS) ||
      (mc_state != IDLE) ||
      ((int32_t)(now - app_motor_next_start_attempt_ms) < 0))
  {
    return;
  }

  if (!AppMotorControl_Start())
  {
    app_motor_next_start_attempt_ms = now + APP_START_RETRY_PERIOD_MS;
  }
}

static void AppMotorControl_UpdateIqLimitRamp(uint32_t now)
{
  if (app_active_iq_limit_a >= app_iq_limit_a)
  {
    app_active_iq_limit_a = app_iq_limit_a;
    return;
  }

  if (app_iq_ramp_last_ms == 0U)
  {
    app_iq_ramp_last_ms = now;
    return;
  }

  uint32_t dt_ms = now - app_iq_ramp_last_ms;
  if (dt_ms == 0U)
  {
    return;
  }

  float step_a = APP_IQ_LIMIT_RAMP_A_PER_S * ((float)dt_ms / 1000.0f);
  app_active_iq_limit_a += step_a;
  if (app_active_iq_limit_a > app_iq_limit_a)
  {
    app_active_iq_limit_a = app_iq_limit_a;
  }

  AppMotorControl_SetIqLimit(app_active_iq_limit_a, false);
  app_iq_ramp_last_ms = now;
}

void AppMotorControl_Task(void)
{
  uint32_t now = HAL_GetTick();
  AppMotorControl_ReportPendingFault();

  /* This protection is independent of logging and NanoEdge AI inference. */
  if (((app_mc_state == APP_MC_STARTING) ||
       (app_mc_state == APP_MC_RUNNING) ||
       (MC_GetSTMStateMotor1() == RUN)) &&
      !AppMotorControl_CheckTemperature(false))
  {
    return;
  }

  AppMotorControl_HandleButtonToggle();

  uint32_t current_faults = MC_GetCurrentFaultsMotor1();
  MCI_State_t mc_state = MC_GetSTMStateMotor1();

  AppMotorControl_ServiceStartRequest(now, current_faults, mc_state);

  if (current_faults != MC_NO_FAULTS)
  {
    if (app_mc_state != APP_MC_FAULT)
    {
      AppMotorControl_TripFault("MCSDK_FAULT");
    }
    return;
  }

  switch (app_mc_state)
  {
    case APP_MC_WAIT_AUTOSTART:
      if ((now - app_mc_boot_ms) >= APP_MOTOR_START_DELAY_MS)
      {
        (void)AppMotorControl_Start();
      }
      break;

    case APP_MC_STARTING:
      if (mc_state == RUN)
      {
        app_mc_state = APP_MC_RUNNING;
        app_mc_run_enter_ms = now;
        app_iq_ramp_last_ms = now;
        app_id_ramp_last_ms = now;
        AppMotorControl_ResetSpeedPi();
        AppMotorControl_SetIqLimit(app_active_iq_limit_a, true);
        AppMotorControl_ApplySpeedReference();
        if (!AppMotorControl_OnMotorRunning(now))
        {
          AppMotorControl_TripFault("LOAD_DAC");
          break;
        }
        app_mc_overcurrent_since_ms = 0U;
        app_mc_overspeed_since_ms = 0U;
      }
      else if ((mc_state == FAULT_NOW) || (mc_state == FAULT_OVER))
      {
        AppMotorControl_TripFault("MCSDK_FAULT");
      }
      else if ((now - app_mc_start_ms) > APP_STARTUP_TIMEOUT_MS)
      {
        AppMotorControl_TripFault("STARTUP_TIMEOUT");
      }
      break;

    case APP_MC_RUNNING:
    {
      if (mc_state != RUN)
      {
        AppMotorControl_TripFault(
          ((mc_state == FAULT_NOW) || (mc_state == FAULT_OVER))
          ? "MCSDK_FAULT" : "MCSDK_STOPPED");
        return;
      }
      if (!AppMotorControl_ServiceCustomStart(now))
      {
        return;
      }
      AppMotorControl_ServiceButtonProfile(now);
      if (!AppMotorControl_ServiceVariableLoad(now))
      {
        AppMotorControl_TripFault("LOAD_DAC");
        return;
      }
      AppMotorControl_UpdateIqLimitRamp(now);

      dq_float_t idq = MC_GetCurrentMotor1_F();

      float i2 = (idq.D * idq.D) + (idq.Q * idq.Q);
      float i_max2 = app_hard_stop_current_a * app_hard_stop_current_a;

      if (!AppMotorControl_IsFiniteFloat(idq.D) ||
          !AppMotorControl_IsFiniteFloat(idq.Q) ||
          !AppMotorControl_IsFiniteFloat(i2))
      {
        AppMotorControl_TripFault("NONFINITE_CURRENT");
        return;
      }

      AppMotorControl_UpdateIdReference(now, idq.Q);

      if ((now - app_mc_run_enter_ms) >= APP_CURRENT_CHECK_AFTER_RUN_MS)
      {
        if (i2 > i_max2)
        {
          if (app_mc_overcurrent_since_ms == 0U)
          {
            app_mc_overcurrent_since_ms = now;
          }

          if ((now - app_mc_overcurrent_since_ms) >= APP_HARD_STOP_DEBOUNCE_MS)
          {
            AppMotorControl_TripFault("HARD_OVERCURRENT");
            return;
          }
        }
        else
        {
          app_mc_overcurrent_since_ms = 0U;
        }
      }

      if ((now - app_mc_run_enter_ms) >= APP_OVERSPEED_CHECK_AFTER_RUN_MS)
      {
        float speed_elec_hz = MC_GetSpeedMotor1_F();
        float speed_rpm = (speed_elec_hz * 60.0f) / (float)POLE_PAIR_NUM;
        float overspeed_reference_rpm = AppMotorControl_GetOverspeedReferenceRpm();
        float speed_limit_rpm = (overspeed_reference_rpm * APP_OVERSPEED_RATIO)
          + APP_OVERSPEED_MARGIN_RPM;

        if (!AppMotorControl_IsFiniteFloat(speed_elec_hz) ||
            !AppMotorControl_IsFiniteFloat(speed_rpm))
        {
          AppMotorControl_TripFault("NONFINITE_SPEED");
          return;
        }

        if (speed_limit_rpm > APP_MOTOR_OVERSPEED_LIMIT_RPM)
        {
          speed_limit_rpm = APP_MOTOR_OVERSPEED_LIMIT_RPM;
        }

        if (speed_rpm < 0.0f)
        {
          speed_rpm = -speed_rpm;
        }

        if (speed_rpm > speed_limit_rpm)
        {
          if (app_mc_overspeed_since_ms == 0U)
          {
            app_mc_overspeed_since_ms = now;
          }

          if ((now - app_mc_overspeed_since_ms) >= APP_OVERSPEED_DEBOUNCE_MS)
          {
            AppMotorControl_TripFault("OVERSPEED");
            return;
          }
        }
        else
        {
          app_mc_overspeed_since_ms = 0U;
        }
      }

      break;
    }

    case APP_MC_FAULT:
      break;

    case APP_MC_IDLE:
    default:
      break;
  }
}
